/*
 * ARTICo3 device tree overlay
 *
 * Author : Alfonso Rodriguez <alfonso.rodriguezm@upm.es>
 * Date   : November 2017
 *
 * "Plug & Play" attachment of the ARTICo3 memory maps into the static
 * device tree of the system.
 *
 */

<a3<artico3_preproc>a3>

/dts-v1/;
/plugin/;

/ {
    fragment@0 {
        target = <&amba_pl>;
        __overlay__ {
<a3<if DEVICE=="zynq">a3>
            artico3: artico3@fpga {
                compatible = "cei.upm,artico3-1.00.a";
                interrupt-parent = <&intc>;
                interrupts = <0 29 1>;
                interrupt-names = "irq";
                reg = <0x7aa00000 0x100000 0x8aa00000 0x100000>;
                reg-names = "ctrl", "data";
                dmas = <&dmac_s 0>;
                dma-names = "ps-dma";
            };
<a3<end if>a3>
<a3<if DEVICE=="zynqmp">a3>
            artico3: artico3@fpga {
                compatible = "cei.upm,artico3-1.00.a";
                interrupt-parent = <&gic>;
                interrupts = <0 89 1>;
                interrupt-names = "irq";
                reg = <0x0 0xa0000000 0x0 0x100000 0x0 0xb0000000 0x0 0x100000>;
                reg-names = "ctrl", "data";
                dmas = <&fpd_dma_chan1 0>;
                dma-names = "ps-dma";
            };
<a3<end if>a3>
        };
    };
};
