/dts-v1/;
/plugin/;

/ {
    model = "Pynq Development Board";
	compatible = "xlnx,zynq-pynq", "xlnx,zynq-7000";

    fragment@0 {    
        target = <&amba_pl>;        
        __overlay__ {                   
            axi4full_test_0: axi4full_test@83c00000 {
                compatible = "cei.upm,proxy-cdma-1.00.a";
                reg = <0x83c00000 0x10000>;
                dmas = <&dmac_s 0>;
                dma-names = "ps-dma";
            };
        };        
    };
};
